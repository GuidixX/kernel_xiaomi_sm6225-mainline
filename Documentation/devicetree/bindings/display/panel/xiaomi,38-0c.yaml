## Documentation/devicetree/bindings/display/panel/xiaomi,38-0c.yaml
```yaml
# SPDX-License-Identifier: (GPL-2.0-only OR BSD-2-Clause)
%YAML 1.2
---
$id: http://devicetree.org/schemas/display/panel/xiaomi,38-0c.yaml#
$schema: http://devicetree.org/meta-schemas/core.yaml#

title: Xiaomi K7 38 0c AMOLED panels

maintainers:
  - Guidix <guidixm@gmail.com>

description: |
  Samsung S6E3FC-based 1080x2400 AMOLED panels used in the Redmi Note 11.
  Revisions 38 0c 0a and 38 0c 0b have different initialization commands.
  Some boards also route their enable signals to different GPIOs. The
  panel revision can be identified by reading the DSI identification registers
  after powering the panel using the corresponding enable signal.

allOf:
  - $ref: panel-common.yaml#

properties:
  compatible:
    enum:
      - xiaomi,38-0c
      - samsung,s6e3fc-unknown

  reg:
    maxItems: 1

  vddio-supply: true

  reset-gpios:
    maxItems: 1

  enable-gpios:
    maxItems: 1
    description: Panel enable signal, used for revision A when enable-b-gpios exists.

  enable-b-gpios:
    maxItems: 1
    description: |
      Optional alternative panel enable signal for revision B. When absent,
      enable-gpios is used for both revisions. The two enable signals must
      not be asserted simultaneously.

  port: true

dependencies:
  enable-b-gpios: [enable-gpios]

required:
  - compatible
  - reg
  - vddio-supply
  - reset-gpios
  - port

unevaluatedProperties: false

examples:
  - |
    #include <dt-bindings/gpio/gpio.h>

    dsi {
        #address-cells = <1>;
        #size-cells = <0>;

        panel@0 {
            compatible = "xiaomi,38-0c";
            reg = <0>;
            vddio-supply = <&vreg_l9a>;
            reset-gpios = <&tlmm 82 GPIO_ACTIVE_LOW>;
            enable-gpios = <&pm6125_gpios 8 GPIO_ACTIVE_HIGH>;
            enable-b-gpios = <&pm6125_gpios 9 GPIO_ACTIVE_HIGH>;

            port {
                panel_in: endpoint {
                    remote-endpoint = <&dsi0_out>;
                };
            };
        };
    };
```

## Documentation/devicetree/bindings/display/panel/xiaomi,k7-38-0c-0b.yaml
```yaml
# SPDX-License-Identifier: (GPL-2.0-only OR BSD-2-Clause)
%YAML 1.2
---
$id: http://devicetree.org/schemas/display/panel/xiaomi,k7-38-0c-0b.yaml#
$schema: http://devicetree.org/meta-schemas/core.yaml#

title: Xiaomi K7 38 0c 0b AMOLED DSI panel

maintainers:
  - Guidix <guidixm@gmail.com>

description:
  Samsung S6E3FC-based 1080x2400 AMOLED panel used by Xiaomi Redmi Note 11
  and Redmi Note 11 NFC. The panel uses four DSI lanes and DSC compression.

allOf:
  - $ref: panel-common.yaml#

properties:
  compatible:
    const: xiaomi,k7-38-0c-0b

  reg:
    maxItems: 1

  vddio-supply: true

  reset-gpios:
    maxItems: 1

  enable-gpios:
    maxItems: 1

required:
  - compatible
  - reg
  - vddio-supply
  - reset-gpios

unevaluatedProperties: false

examples:
  - |
    #include <dt-bindings/gpio/gpio.h>

    dsi {
        #address-cells = <1>;
        #size-cells = <0>;

        panel@0 {
            compatible = "xiaomi,k7-38-0c-0b";
            reg = <0>;
            vddio-supply = <&pm6125_l9>;
            reset-gpios = <&tlmm 82 GPIO_ACTIVE_LOW>;
            enable-gpios = <&pm6125_gpios 9 GPIO_ACTIVE_HIGH>;

            port {
                endpoint {
                    remote-endpoint = <&dsi_out>;
                };
            };
        };
    };
```

## drivers/input/fingerprint/Kconfig
```kconfig
# SPDX-License-Identifier: GPL-2.0-only
source "drivers/input/fingerprint/fpc/Kconfig"
```
